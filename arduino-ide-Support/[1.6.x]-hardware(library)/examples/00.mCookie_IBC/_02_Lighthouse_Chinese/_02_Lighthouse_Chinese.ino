/*
  =================================================================================
                             | 什么是氛围灯? |
  ---------------------------------------------------------------------------------
  用红外遥控器来制造自己的灯光秀！
  遥控器按键对应的灯光效果:
  A. 全彩 + 呼吸效果
  B. 暖色 + 呼吸效果
  C. 冷色 + 呼吸效果
  D. 单色 + 立体效果
  E. 单色 + 呼吸效果

  模式D和E中，你可以用左/右方向键改变颜色:
  红，橙，黄，绿，青，蓝，紫。

  =================================================================================
                                   |开始|
  ---------------------------------------------------------------------------------
  利用红外接收器，遥控器可以实现远程控制！
  =================================================================================
                           |自己动手修改代码! |
  ---------------------------------------------------------------------------------
  点开 userDef.h 文件，然后根据你自己的喜好更改下面的参数。 :)

  BRIGHT_MAX: LED彩灯显示的最大亮度。

  修改完这些值后，记得再把代码上传到mBattery里。
  =================================================================================
                              | 头脑风暴|
  ---------------------------------------------------------------------------------
  1. 除了红外遥控器，还能用什么来控制氛围灯？
     按钮? 光照传感器? 声音传感器?
  2. 可以把LED灯贴在电机上，把它改装成酷炫的灯光秀吗？
     当然可以，也许你可以做出一个迪斯科球!
  3. 可以用纸板来设计一个独特的氛围灯吗?
     你可以在纸板上戳几个洞，做一个星光灯。

    注意: 以上功能上的变动会涉及到程序上的改动。
  =================================================================================
                               | 端口连接|
  ---------------------------------------------------------------------------------
  红外接收器: D4
  ColorLED：  D12
  =================================================================================
                                  | 问题 |
  ---------------------------------------------------------------------------------
  欢迎访问 http://forum.microduino.cn/，在我们的论坛提交您的问题， 我们会尽快回复您。
*/
#include "IRControl.h"
#include "colorLed.h"
#include "userDef.h"


void setup() {
  Serial.begin(9600);
  strip.begin();
  strip.setBrightness(BRIGHT_MAX);
  irrecv.enableIRIn();        //初始化红外接收器，开始接收数据。
#if DEBUG
  Serial.println("**************START************");
#endif
  //每隔0.5秒换一种颜色，总共十种颜色。
  for (int i = 0; i < 10; i++)
  {
    setAllLed(i);
    delay(500);   //每个颜色持续时间
  }
}

void loop() {
  if (irrecv.decode(&results))      //检测到红外信号
  {
#if DEBUG
    Serial.print("Recv Code:");
    Serial.println(results.value, HEX);
#endif
    recvParse(results.value);      //分析接收到的红外信号
    //irrecv.enableIRIn();
    irrecv.resume();              //接收下个值。
  }

  //实时更新彩灯显示效果
  switch (mode)
  {
    case MODE_OFF:
      setAllLed(LOW);
      break;
    case MODE_A:
      ledRainbow(20);            //彩虹效果，每种颜色持续20 ms。
      break;
    case MODE_B:
      ledBreath(COLOR_WARM, 10);
      break;
    case MODE_C:
      ledBreath(COLOR_COLD, 10);
      break;
    case MODE_D:
      setAllLed(colorNum);
      break;
    case MODE_E:
      ledBreath(Color[colorNum], 10);
      break;
    default:
      break;
  }
  delay(20);
}
